## config/west.yml
```yaml
manifest:
  remotes:
    - name: ergohaven
      url-base: https://github.com/ergohaven
    - name: urob
      url-base: https://github.com/urob
    - name: dhruvinsh
      url-base: https://github.com/dhruvinsh
  projects:
    - name: ergohaven-zmk
      remote: ergohaven
      revision: main
      import: config/west.yml
    - name: zmk-adaptive-key
      remote: urob
      revision: main
    - name: zmk-tri-state
      remote: dhruvinsh
      revision: main
  self:
    path: config
```
